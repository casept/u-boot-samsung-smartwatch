## board/samsung/common/Kconfig
```kconfig
config MISC_COMMON
	bool

config SAMSUNG_SBOOT_DEBUG
	bool "Samsung S-Boot crash debugging"
	depends on ARCH_EXYNOS
	select EVENT
	select PANIC_HANG
	select SHOW_BOOT_PROGRESS
	help
	  For boards chainloaded from Samsung's S-Boot. Adds the "ramcon"
	  output device, which keeps a copy of the console in a ring buffer in
	  RAM that survives a warm reset and can be read back in upload mode.
	  List it in stdout and stderr to use it. When U-Boot panics or hangs,
	  it enters S-Boot's upload mode.

config CMD_SBOOT_UPLOAD
	bool "upload - reset into S-Boot's upload mode"
	depends on SAMSUNG_SBOOT_DEBUG
	help
	  Adds the "upload" command, which resets into S-Boot's upload mode
	  like a hang does. The RAM, including the RAM console, can then be
	  read back with an upload mode client.

config SAMSUNG_SBOOT_DEBUG_AREA
	hex "S-Boot debug area"
	depends on SAMSUNG_SBOOT_DEBUG
	default 0x40000000
	help
	  Where S-Boot looks for the upload mode magic and the message to
	  show in upload mode.

config SAMSUNG_SBOOT_RAMCON_ADDR
	hex "Address of the RAM console"
	depends on SAMSUNG_SBOOT_DEBUG
	default 0x46100000
	help
	  The default is the unused half of S-Boot's log area, which Linux
	  doesn't map either.

config SAMSUNG_SBOOT_RAMCON_SIZE
	hex "Size of the RAM console"
	depends on SAMSUNG_SBOOT_DEBUG
	default 0x100000
```

## board/samsung/rinato/Kconfig
```kconfig
if TARGET_RINATO

config SYS_BOARD
	default "rinato"

config SYS_VENDOR
	default "samsung"

config SYS_CONFIG_NAME
	default "rinato"

endif
```

## configs/rinato_defconfig
```kconfig
CONFIG_ARM=y
CONFIG_SKIP_LOWLEVEL_INIT=y
CONFIG_POSITION_INDEPENDENT=y
CONFIG_DRIVER_GICV2=y
CONFIG_ARCH_CPU_INIT=y
CONFIG_ARCH_EXYNOS=y
CONFIG_SUPPORT_PASSING_ATAGS=y
CONFIG_CMDLINE_TAG=y
CONFIG_INITRD_TAG=y
CONFIG_TEXT_BASE=0x43E00000
CONFIG_SYS_MALLOC_LEN=0x2800000
CONFIG_SYS_MALLOC_F_LEN=0x4000
CONFIG_ARCH_EXYNOS3=y
CONFIG_TARGET_RINATO=y
CONFIG_NR_DRAM_BANKS=8
CONFIG_ENV_SIZE=0x4000
CONFIG_DEFAULT_DEVICE_TREE="exynos3250-rinato"
CONFIG_OF_LIBFDT_OVERLAY=y
CONFIG_SYS_MONITOR_LEN=262144
CONFIG_SYS_LOAD_ADDR=0x43e00000
CONFIG_PRE_CON_BUF_ADDR=0x41000000
CONFIG_PRE_CON_BUF_SZ=16384
CONFIG_IDENT_STRING=" for rinato"
CONFIG_SYS_MEM_TOP_HIDE=0x100000
CONFIG_SAMSUNG_SBOOT_DEBUG=y
CONFIG_CMD_SBOOT_UPLOAD=y
# CONFIG_EFI_LOADER is not set
CONFIG_DISTRO_DEFAULTS=y
# CONFIG_ARCH_FIXUP_FDT_MEMORY is not set
# CONFIG_USE_BOOTCOMMAND is not set
CONFIG_CONSOLE_RECORD=y
CONFIG_CONSOLE_RECORD_OUT_SIZE=0x100000
CONFIG_SYS_PBSIZE=1024
CONFIG_PRE_CONSOLE_BUFFER=y
CONFIG_CONSOLE_FLUSH_ON_NEWLINE=y
CONFIG_LOG=y
CONFIG_DISPLAY_BOARDINFO_LATE=y
CONFIG_BOARD_EARLY_INIT_F=y
CONFIG_LAST_STAGE_INIT=y
CONFIG_SYS_PROMPT="rinato # "
CONFIG_CMD_BDINFO_EXTRA=y
CONFIG_CMD_UFETCH=y
CONFIG_CMD_HISTORY=y
# CONFIG_CMD_HISTORY_USE_CALLOC is not set
# CONFIG_CMD_XIMG is not set
CONFIG_CMD_DFU=y
CONFIG_CMD_GPT=y
CONFIG_CMD_I2C=y
CONFIG_CMD_MMC=y
CONFIG_CMD_BKOPS_ENABLE=y
CONFIG_CMD_MMC_REG=y
CONFIG_CMD_MMC_SWRITE=y
CONFIG_MMC_SPEED_MODE_SET=y
CONFIG_CMD_POWEROFF=y
CONFIG_CMD_USB_MASS_STORAGE=y
CONFIG_CMD_SETEXPR_FMT=y
CONFIG_CMD_XXD=y
CONFIG_CMD_BMP=y
CONFIG_CMD_CACHE=y
CONFIG_CMD_TIME=y
# CONFIG_CMD_SLEEP is not set
# CONFIG_CMD_SELECT_FONT is not set
CONFIG_CMD_EXT4_WRITE=y
CONFIG_OF_CONTROL=y
CONFIG_OF_EMBED=y
CONFIG_ENV_OVERWRITE=y
CONFIG_BUTTON=y
CONFIG_BUTTON_GPIO=y
CONFIG_SYS_DFU_DATA_BUF_SIZE=0x2000000
CONFIG_EXTCON=y
CONFIG_EXTCON_MAX77836=y
CONFIG_USB_FUNCTION_FASTBOOT=y
CONFIG_FASTBOOT_BUF_ADDR=0x49000000
CONFIG_FASTBOOT_BUF_SIZE=0x08000000
CONFIG_FASTBOOT_FLASH=y
CONFIG_FASTBOOT_FLASH_MMC_DEV=0
CONFIG_FASTBOOT_MMC_USER_SUPPORT=y
CONFIG_FASTBOOT_CMD_OEM_FORMAT=y
CONFIG_FASTBOOT_OEM_RUN=y
CONFIG_FASTBOOT_CMD_OEM_CONSOLE=y
CONFIG_DM_I2C_GPIO=y
# CONFIG_INPUT is not set
CONFIG_SUPPORT_EMMC_RPMB=y
CONFIG_SUPPORT_EMMC_BOOT=y
CONFIG_MMC_IO_VOLTAGE=y
CONFIG_MMC_UHS_SUPPORT=y
CONFIG_MMC_HS400_ES_SUPPORT=y
CONFIG_MMC_HS400_SUPPORT=y
CONFIG_MMC_DW=y
CONFIG_PHY=y
CONFIG_PHY_EXYNOS_USB2=y
CONFIG_DM_REGULATOR=y
CONFIG_DM_REGULATOR_FIXED=y
CONFIG_SPECIFY_CONSOLE_INDEX=y
CONFIG_CONS_INDEX=2
CONFIG_SOC_SAMSUNG=y
CONFIG_EXYNOS_SPI=y
CONFIG_SYSINFO=y
CONFIG_SYSRESET=y
CONFIG_SYSRESET_CMD_POWEROFF=y
CONFIG_SYSRESET_SYSCON=y
CONFIG_USB=y
CONFIG_DM_USB_GADGET=y
CONFIG_USB_GADGET=y
CONFIG_USB_GADGET_MANUFACTURER="Samsung"
CONFIG_USB_GADGET_VENDOR_NUM=0x1234
CONFIG_USB_GADGET_PRODUCT_NUM=0x1234
CONFIG_USB_GADGET_DWC2_OTG=y
CONFIG_USB_FUNCTION_ACM=y
CONFIG_VIDEO=y
CONFIG_VIDEO_LOGO=y
# CONFIG_VIDEO_BPP8 is not set
# CONFIG_VIDEO_BPP16 is not set
CONFIG_CONSOLE_TRUETYPE=y
CONFIG_CONSOLE_TRUETYPE_SIZE=16
# CONFIG_CONSOLE_TRUETYPE_NIMBUS is not set
CONFIG_CONSOLE_TRUETYPE_DEJAVU=y
CONFIG_VIDEO_RINATO_SIMPLE=y
CONFIG_SPLASH_SCREEN=y
CONFIG_SPLASH_SCREEN_ALIGN=y
# CONFIG_USE_PRIVATE_LIBGCC is not set
CONFIG_TOOLS_MKEFICAPSULE=y
```
