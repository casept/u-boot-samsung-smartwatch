// SPDX-License-Identifier: GPL-2.0+

/dts-v1/;
/ {
	compatible = "samsung,exynos3250", "samsung,exynos3";
	#address-cells = <1>;
	#size-cells = <1>;

	fin_pll: xxti {
		compatible = "fixed-clock";
		clock-output-names = "fin_pll";
		u-boot,dm-pre-reloc;
		#clock-cells = <0>;
	};

	uart2: serial@13820000 {
		compatible = "samsung,exynos4210-uart";
		reg = <0x13820000 0x100>;
		u-boot,dm-pre-reloc;
	};
};


